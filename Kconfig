## Kconfig
```kconfig
# @file Kconfig
# @brief Root configuration menu for muON-DTN application stack and node role selection.
#
# @author Alberto Soncini <alberto.soncini3@studio.unibo.it>
# @author Supervisor: Carlo Caini <carlo.caini@unibo.it>
# @copyright Copyright (c) 2026 Alma Mater Studiorum, University of Bologna.

# muON-DTN Firmware Configuration
mainmenu "muON-DTN Firmware Configuration"

menu "muON Application Settings"
    config MUON_APP_VERSION
        string "muON Firmware Version"
        default "0.1.0"
        help
          Version identifier for muON application stack.

    choice
        prompt "Paper Experiment Node Role"
        default MUON_NODE_ROLE_A
        help
          Select role for reproducing the paper experiment between two Adafruit Feather M0 boards.

        config MUON_NODE_ROLE_A
            bool "Node A (Sensor Source: EID ipn:1.1)"

        config MUON_NODE_ROLE_B
            bool "Node B (Gateway / Relay: EID ipn:2.1)"
    endchoice

    config MUON_LOCAL_NODE_ID
        int "Local Node Number"
        default 1 if MUON_NODE_ROLE_A
        default 2 if MUON_NODE_ROLE_B

    config MUON_REMOTE_NODE_ID
        int "Remote Destination Node Number"
        default 2 if MUON_NODE_ROLE_A
        default 1 if MUON_NODE_ROLE_B
endmenu

menu "muON Network Layer"
    orsource "lib/bpa/Kconfig"
    orsource "lib/clm/Kconfig"
    orsource "lib/routing/Kconfig"
    orsource "lib/lora_cl/Kconfig"
    orsource "lib/uart_cobs_cl/Kconfig"
endmenu

menu "muON Storage Backend Configuration"
    choice
        prompt "muON IStorage Backend"
        default MUON_STORAGE_BACKEND_RAM
        help
          Selects the active IStorage implementation for bundle persistence.
          If SPI Flash is selected, RAM storage is completely disabled to save memory.

    config MUON_STORAGE_BACKEND_RAM
        bool "Internal RAM Storage (ggg::hal::RamStorage)"
        help
          Fast in-memory volatile block storage.

    config MUON_STORAGE_BACKEND_SPI_FLASH
        bool "External SPI NOR Flash Storage (ggg::plugins::SpiFlashStorage)"
        depends on GGG_PLUGIN_SPI_FLASH_STORAGE
        help
          Non-volatile SPI Flash storage (e.g. Winbond W25Q64).
          Only selectable when GGG SPI Flash Storage plugin is enabled.
    endchoice
endmenu

menu "I2C Hardware Bus Configuration"
    config MUON_I2C_SHARED_BUS
        bool "Enable Shared I2C Bus for Peripherals"
        default y
        help
          Enables a shared hardware I2C bus (Wire) for connected peripherals
          (OLED display, BME280 sensor, DS3231 RTC).
          When enabled, all I2C plugins share the common SDA/SCL lines.

    if MUON_I2C_SHARED_BUS
        choice
            prompt "I2C Interface Mode"
            default MUON_I2C_USE_HARDWARE_WIRE
            help
              Use standard MCU hardware Wire peripheral or custom pins.

            config MUON_I2C_USE_HARDWARE_WIRE
                bool "Standard Hardware Wire Peripheral"

            config MUON_I2C_USE_CUSTOM_PINS
                bool "Custom SDA/SCL GPIO Pins"
        endchoice

        if MUON_I2C_USE_CUSTOM_PINS
            config MUON_I2C_PIN_SDA
                int "Shared I2C SDA Pin"
                default 20

            config MUON_I2C_PIN_SCL
                int "Shared I2C SCL Pin"
                default 21
        endif

        config MUON_I2C_CLOCK_SPEED
            int "I2C Bus Clock Frequency (Hz)"
            default 400000
            range 100000 1000000
            help
              Bus speed in Hz (100000 = Standard 100kHz, 400000 = Fast Mode 400kHz).
    endif
endmenu

menu "muON Application Plugins"
    orsource "plugins/*/Kconfig"
endmenu

# Include underlying GGG Core Framework configuration
orsource "../ggg/Kconfig"
```

## lib/bpa/Kconfig
```kconfig
# @file Kconfig
# @brief Configuration menu for BPA retention, metadata capacity, and retries.
#
# @author Alberto Soncini <alberto.soncini3@studio.unibo.it>
# @author Supervisor: Carlo Caini <carlo.caini@unibo.it>
# @copyright Copyright (c) 2026 Alma Mater Studiorum, University of Bologna.

menuconfig MUON_BPA
    bool "Bundle Protocol Agent (BPA) & CBOR Engine"
    default y
    help
      Enable the DTN Bundle Protocol Agent (RFC 9171) and CBOR Serialization Engine.

if MUON_BPA

config MUON_BPA_MAX_BUNDLE_METADATA
    int "Maximum active bundle metadata entries"
    default 16
    range 4 64
    help
      Fixed-size static table capacity for tracking active bundles in custody.

config MUON_BPA_MAX_RETRIES
    int "Maximum convergence layer transmission retries"
    default 3
    range 1 10
    help
      Maximum transmission failures before dropping an unacknowledged bundle.

config MUON_BPA_LOCAL_NODE_ID
    int "Default local node number (IPN schema)"
    default 1
    help
      Default local node number used in IPN endpoint identifiers (e.g. ipn:1.1).

config MUON_BPA_LOCAL_SERVICE_ID
    int "Default local service number (IPN schema)"
    default 1
    help
      Default local service number used in IPN endpoint identifiers.

endif # MUON_BPA
```

## lib/clm/Kconfig
```kconfig
# @file Kconfig
# @brief Configuration menu for Convergence Layer Manager maximum adapters.
#
# @author Alberto Soncini <alberto.soncini3@studio.unibo.it>
# @author Supervisor: Carlo Caini <carlo.caini@unibo.it>
# @copyright Copyright (c) 2026 Alma Mater Studiorum, University of Bologna.

menuconfig MUON_CLM
    bool "Convergence Layer Manager (CLM)"
    default y
    help
      Enable the Convergence Layer Manager orchestrating physical network adapters.

if MUON_CLM

config MUON_CLM_MAX_ADAPTERS
    int "Maximum registered convergence layer adapters"
    default 4
    range 1 8
    help
      Maximum number of active convergence layer adapters supported simultaneously.

endif # MUON_CLM
```

## lib/lora_cl/Kconfig
```kconfig
# @file Kconfig
# @brief Kconfig options for LoRa RF parameters, modem selection, and duty cycle limits.
#
# @author Alberto Soncini <alberto.soncini3@studio.unibo.it>
# @author Supervisor: Carlo Caini <carlo.caini@unibo.it>
# @copyright Copyright (c) 2026 Alma Mater Studiorum, University of Bologna.

menuconfig MUON_LORA_CL_ENABLED
    bool "Enable LoRa Convergence Layer (LoRaCL)"
    default y
    help
      Enables the LoRa Convergence Layer (L2.5) for long-range DTN bundle transfers.

if MUON_LORA_CL_ENABLED

    config MUON_LORA_LINK_ID
        int "Logical Link ID in CLM"
        default 0
        range 0 7
        help
          Unique Link ID assigned to this LoRa Convergence Layer in CLM and Routing.

    choice
        prompt "LoRa Modem Hardware Driver"
        default MUON_LORA_MODEM_SX1276
        help
          Select the physical LoRa transceiver chip.

        config MUON_LORA_MODEM_SX1276
            bool "Semtech SX1276 (e.g. Adafruit Feather M0 RFM95W)"

        config MUON_LORA_MODEM_SX1278
            bool "Semtech SX1278 (433MHz)"

        config MUON_LORA_MODEM_SX1272
            bool "Semtech SX1272"

        config MUON_LORA_MODEM_SX1262
            bool "Semtech SX1262"

        config MUON_LORA_MODEM_MOCK
            bool "Mock Modem (Simulation / Native)"
    endchoice

    config MUON_LORA_PIN_CS
        int "SPI Chip Select (NSS) Pin"
        default 8
        depends on !MUON_LORA_MODEM_MOCK

    config MUON_LORA_PIN_DIO0
        int "DIO0 (IRQ) Pin"
        default 3
        depends on !MUON_LORA_MODEM_SX1262 && !MUON_LORA_MODEM_MOCK

    config MUON_LORA_PIN_RESET
        int "Reset (RST) Pin"
        default 4
        depends on !MUON_LORA_MODEM_MOCK

    config MUON_LORA_PIN_DIO1
        int "DIO1 Pin (SX1262 only)"
        default 6
        depends on MUON_LORA_MODEM_SX1262

    config MUON_LORA_FREQ_MHZ
        int "Carrier Frequency (MHz)"
        default 868
        help
          Standard European SRD band frequency (868 MHz) or 434 MHz.

    config MUON_LORA_SF
        int "Spreading Factor (SF)"
        default 9
        range 6 12

    config MUON_LORA_BW_KHZ
        int "Bandwidth (kHz)"
        default 250

    config MUON_LORA_CR
        int "Coding Rate denominator (5=4/5, 6=4/6, 7=4/7, 8=4/8)"
        default 5
        range 5 8

    config MUON_LORA_TX_POWER_DBM
        int "Transmit Power (dBm)"
        default 14
        range 2 20

    config MUON_LORA_DUTY_CYCLE_ENABLED
        bool "Enforce ETSI 1% Duty Cycle Token Bucket"
        default y
        help
          Enforces maximum 1% Time-on-Air over a 1-hour window (36,000 ms limit).

    config MUON_LORA_REASSEMBLY_TIMEOUT_MS
        int "Reassembly Timeout (ms)"
        default 5000
        help
          Maximum time to wait for all bundle segments before aborting reassembly.

    config MUON_LORA_ACK_TIMEOUT_MS
        int "Block-ACK Timeout (ms)"
        default 3000
        help
          Timeout waiting for BDL_XFER_ACK in Notified Service Class.

endif
```

## lib/routing/Kconfig
```kconfig
# @file Kconfig
# @brief Kconfig options for maximum static routes and default link selection.
#
# @author Alberto Soncini <alberto.soncini3@studio.unibo.it>
# @author Supervisor: Carlo Caini <carlo.caini@unibo.it>
# @copyright Copyright (c) 2026 Alma Mater Studiorum, University of Bologna.

menuconfig MUON_ROUTING
    bool "Static Routing Engine"
    default y
    help
      Enable the Static Routing Engine for IPN endpoint mapping to physical links.

if MUON_ROUTING

config MUON_ROUTING_MAX_STATIC_ROUTES
    int "Maximum static route table entries"
    default 8
    range 2 32
    help
      Maximum number of static routes maintained in fast O(1) table.

endif # MUON_ROUTING
```

## lib/uart_cobs_cl/Kconfig
```kconfig
# @file Kconfig
# @brief Configuration options for UART baudrate, port selection, and timeouts.
#
# @author Alberto Soncini <alberto.soncini3@studio.unibo.it>
# @author Supervisor: Carlo Caini <carlo.caini@unibo.it>
# @copyright Copyright (c) 2026 Alma Mater Studiorum, University of Bologna.

menuconfig MUON_UART_COBS_CL_ENABLED
    bool "Enable UART-COBS Convergence Layer (UARTCL-COBS)"
    default y
    help
      Enables the COBS-framed UART Convergence Layer (L2.5) with CRC-16 CCITT-FALSE.

if MUON_UART_COBS_CL_ENABLED

    config MUON_UART_COBS_LINK_ID
        int "Logical Link ID in CLM"
        default 1
        range 0 7
        help
          Unique Link ID assigned to this UART-COBS Convergence Layer in CLM and Routing.

    config MUON_UART_COBS_BAUDRATE
        int "Serial Baudrate"
        default 115200

    config MUON_UART_COBS_TIME_SYNC_ENABLED
        bool "Enable DTN Epoch Time Synchronization"
        default y
        help
          Requests and accepts time sync frames (UARTCL_FLAG_SYNC) from the Gateway.

endif
```

## plugins/led_actuator/Kconfig
```kconfig
# @file Kconfig
# @brief Configuration menu for muON LED Actuator Plugin.
#
# @author Alberto Soncini <alberto.soncini3@studio.unibo.it>
# @author Supervisor: Carlo Caini <carlo.caini@unibo.it>
# @copyright Copyright (c) 2026 Alma Mater Studiorum, University of Bologna.

menuconfig MUON_PLUGIN_LED_ACTUATOR
    bool "LED Actuator Plugin"
    default y
    help
      Registers an application endpoint (service ID) for the Bundle Protocol Agent,
      consumes delivered DTN bundles addressed to this service, and toggles a GPIO LED.

if MUON_PLUGIN_LED_ACTUATOR

    config MUON_ACTUATOR_PIN
        int "Actuator LED GPIO Pin"
        default 13
        help
          Pin connected to the LED or actuator (13 is LED_BUILTIN on Adafruit Feather M0).

    config MUON_ACTUATOR_SERVICE_ID
        int "Actuator DTN Application Service ID (IPN)"
        default 2
        help
          The DTN service ID to which command bundles must be addressed (e.g. ipn:1.2).

endif
```

## plugins/oled_display/Kconfig
```kconfig
# @file Kconfig
# @brief Configuration menu for muON OLED Display Plugin (SSD1306/SSD1315).
#
# @author Alberto Soncini <alberto.soncini3@studio.unibo.it>
# @author Supervisor: Carlo Caini <carlo.caini@unibo.it>
# @copyright Copyright (c) 2026 Alma Mater Studiorum, University of Bologna.

menuconfig MUON_PLUGIN_OLED_DISPLAY
    bool "OLED Display Plugin (SSD1306 / SSD1315 via I2C)"
    default y
    help
      Enables status dashboard and DTN message viewer on I2C OLED display.

if MUON_PLUGIN_OLED_DISPLAY

    choice
        prompt "OLED Display Controller"
        default MUON_OLED_CONTROLLER_SSD1306
        help
          Select the OLED driver controller chip.

    config MUON_OLED_CONTROLLER_SSD1306
        bool "Solomon Systech SSD1306"

    config MUON_OLED_CONTROLLER_SSD1315
        bool "Solomon Systech SSD1315"
    endchoice

    choice
        prompt "Screen Resolution"
        default MUON_OLED_RES_128X64
        help
          Physical pixel dimensions of the display panel.

    config MUON_OLED_RES_128X64
        bool "128 x 64 Pixels"

    config MUON_OLED_RES_128X32
        bool "128 x 32 Pixels"
    endchoice

    choice
        prompt "U8g2 Paging / Buffer Strategy"
        default MUON_OLED_BUFFER_PAGE
        help
          Select memory footprint strategy:
          Page buffer requires only 128 bytes of RAM (ideal for SAMD21).
          Full buffer requires 1024 bytes of RAM.

    config MUON_OLED_BUFFER_PAGE
        bool "Page Buffer (128 Bytes RAM - Low Memory)"

    config MUON_OLED_BUFFER_FULL
        bool "Full Framebuffer (1024 Bytes RAM - Fast Refresh)"
    endchoice

    config MUON_OLED_I2C_ADDRESS
        hex "OLED I2C Address"
        default 0x3C
        help
          I2C address of OLED display (usually 0x3C or 0x3D).

    config MUON_OLED_HAS_RESET_PIN
        bool "Display Module Has Hardware Reset Pin"
        default n
        help
          Enable if your OLED breakout board exposes an active-low RST pin.
          If disabled, U8X8_PIN_NONE is used.

    config MUON_OLED_PIN_RESET
        int "Reset (RST) Pin Number"
        default -1
        depends on MUON_OLED_HAS_RESET_PIN
        help
          GPIO pin connected to display /RES line.

    if !MUON_I2C_SHARED_BUS
        config MUON_OLED_PIN_SDA
            int "Dedicated OLED SDA Pin"
            default 20

        config MUON_OLED_PIN_SCL
            int "Dedicated OLED SCL Pin"
            default 21
    endif

    config MUON_OLED_APP_SERVICE_ID
        int "BPA Application Service ID for Display"
        default 10
        range 1 255
        help
          Destination service number (ipn:<node>.<service>) delivered to this display.
          Incoming bundles destined to this service ID are parsed and printed on screen.

    config MUON_OLED_REFRESH_RATE_HZ
        int "Display Refresh Rate (Hz)"
        default 2
        range 1 10
        help
          Maximum screen redraw frequency to prevent FreeRTOS task starvation.

endif
```
